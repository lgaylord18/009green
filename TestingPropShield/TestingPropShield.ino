#include <SPI.h>
#include <MFRC522.h>
#include <Talkie.h>

//SPI CONNECTION
#define RST_PIN      8//floating
#define SS_PIN      10
//MISO 12
//MOSI 11
#define LED_PIN     13
#define SCK_PIN     14
#define BUTTON_0     8
#define BUTTON_1     9
#define BUTTON_2    16


Talkie voice;
MFRC522 mfrc522(SS_PIN, RST_PIN);      // Create MFRC522 instance

////////////////////////////////////////
/////////   GLOBAL VARIABLES   /////////
////////////////////////////////////////
int numCards = 0;                 // Set number of RFID tags you want
int gameNum = 0;
int numGames = 2;
int numValues = 12;
int gameMode = 0;
int lastGameMode = 0;

const int FlashChipSelect = 6;


// CARD CLASS
class Card {
  public:
   int valueIndex;
   uint8_t UID[4];
};

Card Cards[100];

uint8_t words[][180] PROGMEM = {
  // ERROR
  {0x2B,0xAF,0xC9,0x9C,0xDC,0x97,0x9E,0xBC,0xE5,0x34,0x72,0x5F,0x77,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0x00,0x00},
  // READY
  {0x6A,0xB4,0xD9,0x25,0x4A,0xE5,0xDB,0xD9,0x8D,0xB1,0xB2,0x45,0x9A,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0x7F,},
  // COMPLETE
  {0x0E,0x68,0xA1,0x43,0x03,0xA7,0x2E,0xB2,0x22,0x0B,0xBB,0xDC,0x76,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0xFC,0x7F},
  // TO
  {0x02,0xD8,0x51,0x3C,0x00,0xC7,0x7A,0x18,0x20,0x85,0xE2,0xE5,0x16,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0x75,0xF2},
  // PLAY
  {0x06,0xC8,0x55,0x54,0x01,0x49,0x69,0x94,0xC4,0xA4,0x1C,0xE3,0x8A,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0x00,0x00},
  // RANDOMLY
  {0xAA,0xA5,0x35,0xCD,0xAD,0x9C,0x84,0x56,0x0C,0xEE,0x2C,0xD3,0xBC,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0x00,0x00},
  // READ
  {0xA1,0x13,0x31,0x5C,0x3C,0x95,0x95,0x4E,0x56,0x33,0x75,0x93,0xDF,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0xD3,0x03},
};

uint8_t values[][110] PROGMEM = {
  // ZERO
  {0x69,0xFB,0x59,0xDD,0x51,0xD5,0xD7,0xB5,0x6F,0x0A,0x78,0xC0,0x52,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0xFF,0x1F},
  // ONE
  {0x66,0x4E,0xA8,0x7A,0x8D,0xED,0xC4,0xB5,0xCD,0x89,0xD4,0xBC,0xA2,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0xFE,0x1F},
  // TWO
  {0x06,0xB8,0x59,0x34,0x00,0x27,0xD6,0x38,0x60,0x58,0xD3,0x91,0x55,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0xFF,0x1F},
  // THREE
  {0x0C,0xE8,0x2E,0x94,0x01,0x4D,0xBA,0x4A,0x40,0x03,0x16,0x68,0x69,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0xFF,0x03},
  // FOUR
  {0x08,0x68,0x21,0x0D,0x03,0x04,0x28,0xCE,0x92,0x03,0x23,0x4A,0xCA,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0xF2,0xFF},
  // FIVE
  {0x08,0x68,0x4E,0x9D,0x02,0x1C,0x60,0xC0,0x8C,0x69,0x12,0xB0,0xC0,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0xFF,0x01},
  // SIX
  {0x04,0xF8,0xAD,0x4C,0x02,0x16,0xB0,0x80,0x06,0x56,0x35,0x5D,0xA8,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0xFF,0x01},
  // SEVEN
  {0x0C,0xF8,0x5E,0x4C,0x01,0xBF,0x95,0x7B,0xC0,0x02,0x16,0xB0,0xC0,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0xFB,0x7F},
  // EIGHT
  {0x65,0x69,0x89,0xC5,0x73,0x66,0xDF,0xE9,0x8C,0x33,0x0E,0x41,0xC6,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0xF8,0x7F},
  // NINE
  {0xE6,0xA8,0x1A,0x35,0x5D,0xD6,0x9A,0x35,0x4B,0x8C,0x4E,0x6B,0x1A,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0xFF,0x0F},
  // TEN
  {0x0E,0x38,0x3C,0x2D,0x00,0x5F,0xB6,0x19,0x60,0xA8,0x90,0x93,0x36,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0xFF,0x03},
  // ELEVEN
  {0xA5,0xEF,0xD6,0x50,0x3B,0x67,0x8F,0xB9,0x3B,0x23,0x49,0x7F,0x33,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0xFF,0x0F},
  // TWELVE
  {0x09,0x98,0xDA,0x22,0x01,0x37,0x78,0x1A,0x20,0x85,0xD1,0x50,0x3A,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0xFE,0x1F}, 
  // TWENTY
  {0x0A,0xE8,0x4A,0xCD,0x01,0xDB,0xB9,0x33,0xC0,0xA6,0x54,0x0C,0xA4,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0xFF,0x1F},
};


////////////////////////////////////////


////////////////////////////////////////
/////////   HELPER FUNCTIONS   /////////
////////////////////////////////////////

// Gets the value from the list of UID
int findCard(int uidLength, uint8_t uidValue[]) {
    for (int i=0; i < numCards; i++) {

        if (uidMatch(uidLength, uidValue, Cards[i].UID)) {
          return i;
      }
    }
    return -1;
}

boolean uidMatch(int uidLength, uint8_t uid1[], uint8_t uid2[]) {
  for (int j=0; j < uidLength; j++) {
    if (uid1[j] != uid2[j]) {
      return false;
    }
  }
  return true;
}

void addCard(uint8_t* uidValue) {
  Card c1;
  c1.valueIndex = (int)random(numValues);
  c1.UID[0] = uidValue[0];
  c1.UID[1] = uidValue[1];
  c1.UID[2] = uidValue[2];
  c1.UID[3] = uidValue[3];
  Cards[numCards] = c1;
  numCards ++;
  Serial.println("Card Added!: ");
  Serial.print(c1.UID[0]);Serial.print(c1.UID[1]);Serial.print(c1.UID[2]);Serial.println(c1.UID[3]);
  Serial.print("Total Cards: ");Serial.println(numCards);Serial.println("");
  voice.say(words[2]);

}

void randomizeValues() {
    for (int i=0; i < numCards; i++) {
        Card card = Cards[i];
        card.valueIndex = (int)random(numValues);
        Cards[i] = card;
    }
    Serial.println("Randomized");
//    voice.say(words[0]);
}

void nextGame() {
  gameNum ++;
  if (gameNum > numGames) {
    gameNum = 0;
  }
}

// turn the LED on
void ledOn() {
  digitalWrite(LED_PIN, HIGH);   
}

// turn the LED off
void ledOff() {
  digitalWrite(LED_PIN, LOW);    
}

void welcomeMessage() {
  voice.say(words[3]);
  voice.say(words[2]);
  voice.say(words[1]);
}

////////////////////////////////////////

void setup() {
  randomSeed(analogRead(0));      // Randomize seed
  SPI.setSCK(SCK_PIN);            // Start SPI clock
  SPI.begin();                    // Init SPI bus
  mfrc522.PCD_Init();             // Init MFRC522
  pinMode(LED_PIN, OUTPUT);     
  
  // BUTTONS
  pinMode(BUTTON_0, INPUT_PULLUP);
  attachInterrupt(BUTTON_0, B0_ISR, RISING);
  pinMode(BUTTON_1, INPUT_PULLUP);
  attachInterrupt(BUTTON_1, B1_ISR, RISING);
  pinMode(BUTTON_2, INPUT_PULLUP);
  attachInterrupt(BUTTON_2, B2_ISR, RISING);
  
  digitalWrite(LED_PIN, HIGH);    // turn the LED on 
  Serial.println("Connected");
  randomizeValues();
  welcomeMessage();

// AUDIO AMP SETUP
//  AudioMemory(20);
//  dac1.analogReference(EXTERNAL); // much louder!
  delay(50);             // time for DAC voltage stable
  pinMode(5, OUTPUT);
  digitalWrite(5, HIGH); // turn on the amplifier
  delay(10);             // allow time to wake up
}

void loop() {
  //Check if game mode has changed
  if (gameMode != lastGameMode) {
     if (gameMode == 0) {
         voice.say(words[1]);
     }
      if (gameMode == 1) {
         voice.say(words[6]);
     }
      if (gameMode == 2) {
         voice.say(words[5]);
     }
  }
  lastGameMode = gameMode;

  
  // SHUFFLING
  if (gameMode == 2) {
    randomizeValues();
    if (gameMode == 2) {  // Only changed if interrupt during randomize
        gameMode = 1;     // Go back to read mode after a shuffle
    }
    return;
  }
  
  // Look for new cards. Return if not found
  if ( ! mfrc522.PICC_IsNewCardPresent()) {
    return;
  }
  // Select one of the cards
  if ( ! mfrc522.PICC_ReadCardSerial()) {
    return;
  }

  
  // Card found
  byte* uidValue = mfrc522.uid.uidByte;
  uint8_t uidLength = 4;
  int cardNum = findCard(uidLength, uidValue);


  if (gameMode == 0) {
    if (cardNum == -1) {
      addCard(uidValue);
    }
    else {
      Serial.println("Card already exists");Serial.println("");
      voice.say(words[0]);
    }
  }

  if (gameMode == 1) {
    if (cardNum != -1) {
      Serial.println("Found card: "); Serial.print(uidValue[0]);Serial.print(uidValue[1]);Serial.print(uidValue[2]);Serial.println(uidValue[3]);Serial.println("");
      voice.say(values[Cards[cardNum].valueIndex]);
    } else {
      Serial.println("Unkown card");Serial.println("");
      voice.say(words[0]);
    }
  }

  Serial.println("Card Scanned: "); Serial.print(uidValue[0]);Serial.print(uidValue[1]);Serial.print(uidValue[2]);Serial.println(uidValue[3]);Serial.println("");


  
  ledOff();    // SHOW GOT A CARD
  delay(300);  // SHOW GOT A CARD
  ledOn();     // SHOW GOT A CARD
}


  
////////////////////////////////////////
////////////   ISR  ///////////
////////////////////////////////////////
void B0_ISR() {
  if (gameMode == 0) {
    
  } else {
    Serial.println("PAIRING");
    gameMode = 0;
  }

  // Delay a little bit to avoid bouncing
  delay(100);
}

void B1_ISR() {
  if (gameMode == 1) {
    
  } else {
    Serial.println("READ");
    gameMode = 1;
  }

  // Delay a little bit to avoid bouncing
  delay(100);
}

void B2_ISR() {
    if (gameMode == 2) {
    
  } else {
    Serial.println("SHUFFLE");
    gameMode = 2;
  }

  delay(100);
}
